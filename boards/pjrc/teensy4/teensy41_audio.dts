/*
 * Author: Nick McCarty nick@inphaseembedded.com
 *
 * SPDX-License-Identifier: Apache-2.0
 */

#include "teensy41.dts"

/ {
	model = "PJRC TEENSY 4.1 board with Audio board support";

	chosen {
		zephyr,flash-controller = &w25q64jvxgim;
		zephyr,flash = &w25q64jvxgim;
	};
};

