## boards/pjrc/teensy4/Kconfig.defconfig
```kconfig
#
# Author: Nick McCarty nick@inphaseembedded.com
#
# SPDX-License-Identifier: Apache-2.0
#

if BOARD_TEENSY40 || BOARD_TEENSY41 || BOARD_TEENSYMM || BOARD_TEENSY41_AUDIO

config BUILD_OUTPUT_HEX
	bool
	default y

config DISK_DRIVER_SDMMC
	default y if DISK_DRIVERS

if NETWORKING

config NET_L2_ETHERNET
	default n if BOARD_TEENSY40
	default y if(BOARD_TEENSY41 || BOARD_TEENSY41_AUDIO)

endif # NETWORKING

endif # BOARD_TEENSY40 || BOARD_TEENSY41
```

## boards/pjrc/teensy4/Kconfig.teensy41_audio
```kconfig
#
# Author: Nick McCarty nick@inphaseembedded.com
# SPDX-License-Identifier: Apache-2.0
#

config BOARD_TEENSY41_AUDIO
	select SOC_PART_NUMBER_MIMXRT1062DVL6A
```

## drivers/audio/Kconfig.sgtl5000
```kconfig
# Author Nick McCarty nick@inphaseembedded.com
# SPDX-License-Identifier: Apache-2.0

config AUDIO_CODEC_SGTL5000
	bool "NXP SGTL5000 codec support"
	default y
	select I2C
	depends on DT_HAS_NXP_SGTL5000_ENABLED
	help
	  Enable support for the NXP SGTL5000 codec
```
